/*
 * Copyright (c) 2020 ZMK Contributors
 *
 * SPDX-License-Identifier: MIT
 */
 
#include "scylla.dtsi"

&default_transform {
	col-offset = <6>;
};

&kscan0 {
	row-gpios
		= <&pro_micro  14 (GPIO_ACTIVE_HIGH | GPIO_PULL_DOWN)>
		, <&pro_micro  15 (GPIO_ACTIVE_HIGH | GPIO_PULL_DOWN)>
		, <&pro_micro  18 (GPIO_ACTIVE_HIGH | GPIO_PULL_DOWN)>
		, <&pro_micro  19 (GPIO_ACTIVE_HIGH | GPIO_PULL_DOWN)>
		, <&pro_micro  20 (GPIO_ACTIVE_HIGH | GPIO_PULL_DOWN)>
		, <&pro_micro  21 (GPIO_ACTIVE_HIGH | GPIO_PULL_DOWN)>
		;
};
